## main/Kconfig.projbuild
```kconfig
menu "LoRa Mesh Gateway"
    config LMESH_RADIO_WIO
        bool "Radio: Seeed Wio-E5 (LoRa star network) instead of Ebyte E52 (mesh)"
        default n
        help
            Build the radio driver shared/wio.c instead of shared/e52.c. The
            Wio-E5 runs its factory AT firmware in test mode as a plain LoRa
            radio; addressing, acknowledgements and retries are done by wio.c.
            Build a separate configuration for it, see sdkconfig.wio.defaults.
    config LMGW_E52_USB
        bool "Radio board on USB-HS (OTG) port: E52 via CH340, Wio-E5 via CP2102N or CH340 (else UART pins)"
        default y
    config LMGW_E52_UART_NUM
        int "UART port for E52"
        default 1
    config LMGW_E52_TX_GPIO
        int "ESP TX -> E52 RXD (pin 10) GPIO"
        default 17
    config LMGW_E52_RX_GPIO
        int "ESP RX <- E52 TXD (pin 9) GPIO"
        default 18
    config LMGW_E52_RST_GPIO
        int "E52 NRST (pin 17) GPIO, -1 = not wired"
        default -1
    config LMGW_E52_BAUD
        int "E52 UART baud"
        default 115200
endmenu
```

## node/main/Kconfig.projbuild
```kconfig
menu "LMESH node"
    config LMESH_RADIO_WIO
        bool "Radio: Seeed Wio-E5 (LoRa star network) instead of Ebyte E52 (mesh)"
        default n
        help
            Build the radio driver shared/wio.c instead of shared/e52.c. The
            Wio-E5 runs its factory AT firmware in test mode as a plain LoRa
            radio; addressing, acknowledgements and retries are done by wio.c.
            Build a separate configuration for it, see sdkconfig.wio.defaults.
    config LMGW_E52_UART_NUM
        int "UART port for E52"
        default 1
    config LMGW_E52_TX_GPIO
        int "ESP TX -> E52 RXD GPIO (XIAO D4)"
        default 22
    config LMGW_E52_RX_GPIO
        int "ESP RX <- E52 TXD GPIO (XIAO D5)"
        default 23
    config LMGW_E52_RST_GPIO
        int "E52 reset GPIO, -1 = not wired (XIAO D6 = 16)"
        default -1
    config LMGW_E52_BAUD
        int "E52 UART baud"
        default 115200
    config LMN_RS485_UART_NUM
        int "UART port for RS-485"
        default 0
    config LMN_RS485_TX_GPIO
        int "ESP TX -> RS-485 board GPIO (XIAO D2)"
        default 2
    config LMN_RS485_RX_GPIO
        int "ESP RX <- RS-485 board GPIO (XIAO D3)"
        default 21
    config LMN_XIAO_C6_ANT
        bool "Seeed XIAO ESP32-C6 antenna switch (GPIO3/GPIO14)"
        default y
endmenu
```

## node/sdkconfig.defaults
```kconfig
CONFIG_IDF_TARGET="esp32c6"
CONFIG_ESPTOOLPY_FLASHSIZE_4MB=y
CONFIG_PARTITION_TABLE_SINGLE_APP_LARGE=y
CONFIG_ESP_CONSOLE_USB_SERIAL_JTAG=y
CONFIG_HTTPD_MAX_REQ_HDR_LEN=1024
CONFIG_HTTPD_MAX_URI_LEN=512
CONFIG_ESP_MAIN_TASK_STACK_SIZE=6144
CONFIG_FREERTOS_HZ=1000
CONFIG_LOG_DEFAULT_LEVEL_INFO=y
```

## sdkconfig.defaults
```kconfig
CONFIG_PARTITION_TABLE_CUSTOM=y
CONFIG_PARTITION_TABLE_CUSTOM_FILENAME="partitions.csv"
CONFIG_ESPTOOLPY_FLASHSIZE_4MB=y
CONFIG_HTTPD_MAX_REQ_HDR_LEN=1024
CONFIG_HTTPD_MAX_URI_LEN=512
CONFIG_LWIP_MAX_SOCKETS=16
CONFIG_ESP_MAIN_TASK_STACK_SIZE=6144
CONFIG_FREERTOS_HZ=1000
CONFIG_LOG_DEFAULT_LEVEL_INFO=y
```
